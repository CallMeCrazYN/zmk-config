## config/west.yml
```yaml
manifest:
  remotes:
    - name: zmkfirmware
      url-base: https://github.com/zmkfirmware
    # Additional modules containing boards/shields/custom code can be listed here as well
    # See https://docs.zephyrproject.org/3.2.0/develop/west/manifest.html#projects
    - name: zmk_locales_base
      url-base: htttps://github.com/joelspadin
  projects:
    - name: zmk
      remote: zmkfirmware
      revision: main
      import: app/west.yml
      #- name: zmk-locales
      #  remote: zmk_locales_base
      #  revision: main
  self:
    path: config
```
